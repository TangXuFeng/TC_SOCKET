ENTRY(_start)

SECTIONS
{
    . = 0x80000000;

    .text : {
        *(.text*)
    }

    .rodata : {
        *(.rodata*)
    }

    .data : {
        *(.data*)
    }

    .bss : {
        *(.bss*)
        *(COMMON)
    }

    /* 定义 4KB 栈 */
    _stack_size = 4K;

    _stack_bottom = .;
    . = . + _stack_size;
    _stack_top = .;
}
